## main/Kconfig.projbuild
```kconfig
menu "Humidity configuration"

    config BROKER_URL
        string "Broker URL"
        default "mqtt://mqtt.eclipse.org"
        help
            MQTT broker URL.

    config ESP_WIFI_SSID
        string "Wifi SSID"
        default "myssid"
        help
            Wifi SSID (network name).

    config ESP_WIFI_PASSWORD
        string "Wifi password"
        default "mypassword"
        help
            WPA or WPA2 password for Wifi.

    config ESP_WIFI_RETRY
        int "Wifi retry attempts"
        default 5
        help
            Maximum number of retry attempts when connecting to an AP.

endmenu
```
